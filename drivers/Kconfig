## drivers/Kconfig
```kconfig
menu "MIDI1 serial UART" 
config MIDI1_SERIAL
    bool "MIDI1 UART driver"
    default y
    help
      Enable the MIDI1 serial driver.
      
config MIDI1_SERIAL_RUNNING_STATUS_REPEAT
    int "After how many times without a status byte do we send a new one"
    default 16
    range 0 64
    help
      The default 16 is recommended by the MIDI1.0 spec.  If you set this
      to 0 the status byte is always sent.

config MIDI1_SERIAL_RUNNING_STATUS_TIMEOUT_MS
    int "Running status timeout (ms)"
    default 300
    range 50 300
    help
      If no status byte has been sent within this timeout, the driver will
      automatically send a new status byte.

config MIDI1_SERIAL_ISR_MSGQ_SIZE_MS
    int "Size of the rx message queue"
    default 128
    range 8 512
    help
      Size of the MSGQ keep this one as small as possible to avoid queueing 
      latency.

endmenu

menu "MIDI1 clock counter driver"
config MIDI1_CLOCK_COUNTER
    bool "MIDI1 clock counter driver"
    default y
    help
      Enable the MIDI1 clock counter driver.
endmenu
```

## src/Kconfig
```kconfig
menu "[ Human MIDI BPM clock MIDI1 application settings ]" 
config PLL_FILTER_K
    int "PLL filter K value"
    default 4
    range 1 64
    help
	Filter K value Low‑pass filter strength keep it high... sudden tempo
	changes should be followed though.
config PLL_FILTER_GAIN
    int "PLL filter gain value"
    default 4
    range 1 64
    help
	Filter Gain value Correction gain keep it low we want to move towards
	the value but not overshoot
config PLL_TRACK_GAIN
    int "PLL tracking gain value"
    default 32
    range 1 128
    help
	Filter Slow loop Tracking Gain value
endmenu
```
